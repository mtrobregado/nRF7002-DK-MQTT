## mqtt/build/Kconfig/Kconfig.shield.defconfig
```kconfig
osource "c:/ncs/v2.4.2/nrf/samples/wifi/shell/boards/shields/*/Kconfig.defconfig"
osource "c:/ncs/v2.4.2/nrf/samples/nrf9160/nrf_cloud_mqtt_multi_service/boards/shields/*/Kconfig.defconfig"
osource "c:/ncs/v2.4.2/nrf/samples/net/mqtt/boards/shields/*/Kconfig.defconfig"
osource "c:/ncs/v2.4.2/zephyr/samples/net/sockets/http_get/boards/shields/*/Kconfig.defconfig"
osource "c:/ncs/v2.4.2/nrf/samples/nrf9160/https_client/boards/shields/*/Kconfig.defconfig"
osource "C:/ncs/v2.4.2/nrf/boards/shields/*/Kconfig.defconfig"
```
